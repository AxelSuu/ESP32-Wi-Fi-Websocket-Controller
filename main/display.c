#include "display.h"
#include "game.h"
#include "config.h"
#include <string.h>
#include <stdio.h>
#include "driver/spi_master.h"
#include "driver/gpio.h"
#include "esp_log.h"
#include "freertos/FreeRTOS.h"
#include "freertos/task.h"

static const char *TAG = "display";

#define FRAMEBUF_SIZE  (SCREEN_WIDTH * SCREEN_HEIGHT / 2)  // 6144 bytes

static spi_device_handle_t s_spi;
static uint8_t s_framebuf[FRAMEBUF_SIZE];

// Standard Adafruit 5x7 font, column-major, bit0=top row. ASCII 0x20–0x7F.
static const uint8_t font5x7[96][5] = {
    {0x00, 0x00, 0x00, 0x00, 0x00}, // 0x20 ' '
    {0x00, 0x00, 0x5F, 0x00, 0x00}, // 0x21 '!'
    {0x00, 0x07, 0x00, 0x07, 0x00}, // 0x22 '"'
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    {0x00, 0x00, 0x00, 0x00, 0x00}, // 0x7F DEL
};

// --- Low-level SPI helpers ---

static void ssd1327_cmd(uint8_t cmd)
{
    gpio_set_level(OLED_DC, 0);
    spi_transaction_t t = {
        .length   = 8,
        .tx_data  = {cmd},
        .flags    = SPI_TRANS_USE_TXDATA,
    };
    spi_device_polling_transmit(s_spi, &t);
}

static void ssd1327_data_buf(const uint8_t *data, size_t len)
{
    if (len == 0) return;
    gpio_set_level(OLED_DC, 1);
    spi_transaction_t t = {
        .length    = len * 8,
        .tx_buffer = data,
    };
    spi_device_polling_transmit(s_spi, &t);
}

// --- Framebuffer pixel write ---
// SSD1327 pixel layout: byte[x/2 + y*64], x-even→high nibble, x-odd→low nibble

static inline void set_pixel(int x, int y, uint8_t nibble)
{
    if (x < 0 || x >= SCREEN_WIDTH || y < 0 || y >= SCREEN_HEIGHT) return;
    int idx = y * 64 + x / 2;
    nibble &= 0x0F;
    if (x & 1) {
        s_framebuf[idx] = (s_framebuf[idx] & 0xF0) | nibble;
    } else {
        s_framebuf[idx] = (s_framebuf[idx] & 0x0F) | (nibble << 4);
    }
}

static void fill_screen(uint8_t nibble)
{
    uint8_t b = ((nibble & 0x0F) << 4) | (nibble & 0x0F);
    memset(s_framebuf, b, FRAMEBUF_SIZE);
}

static void draw_rect_filled(int x, int y, int w, int h, uint8_t color)
{
    for (int row = y; row < y + h; row++) {
        for (int col = x; col < x + w; col++) {
            set_pixel(col, row, color);
        }
    }
}

static void draw_circle_filled(int cx, int cy, int r, uint8_t color)
{
    for (int dy = -r; dy <= r; dy++) {
        int dx = 0;
        while (dx * dx + dy * dy <= r * r) dx++;
        dx--;
        for (int x = cx - dx; x <= cx + dx; x++) {
            set_pixel(x, cy + dy, color);
        }
    }
}

static void draw_char(int x, int y, char c, uint8_t color)
{
    if (c < 0x20 || c > 0x7F) c = '?';
    const uint8_t *glyph = font5x7[(uint8_t)c - 0x20];
    for (int col = 0; col < 5; col++) {
        uint8_t line = glyph[col];
        for (int row = 0; row < 7; row++) {
            if (line & (1 << row)) {
                set_pixel(x + col, y + row, color);
            }
        }
    }
}

static void draw_string(int x, int y, const char *str, uint8_t color)
{
    while (*str) {
        draw_char(x, y, *str++, color);
        x += 6;
        if (x >= SCREEN_WIDTH) break;
    }
}

static void display_flush(void)
{
    // Set column address 0–63 (128 pixels / 2 per byte)
    ssd1327_cmd(0x15);
    ssd1327_cmd(0x00);
    ssd1327_cmd(0x3F);
    // Set row address 0–95
    ssd1327_cmd(0x75);
    ssd1327_cmd(0x00);
    ssd1327_cmd(0x5F);
    // Send framebuffer
    ssd1327_data_buf(s_framebuf, FRAMEBUF_SIZE);
}

// --- Screen drawing ---

static void draw_start_screen(void)
{
    fill_screen(0x0);
    draw_string(25, 10, "ESP32 PONG", 0xF);
    draw_string(10, 30, "Connect to WiFi:", 0xF);
    draw_string(15, 42, "ESP32-Pong", 0xF);
    draw_string(10, 58, "Open browser and", 0xF);
    draw_string(10, 70, "click START GAME", 0xF);
    draw_string( 5, 85, "IP: 192.168.4.1", 0xF);
    display_flush();
}

static void draw_game_over_screen(void)
{
    fill_screen(0x0);
    draw_string(25, 10, "GAME OVER!", 0xF);
    if (g_game.player_score >= WIN_SCORE) {
        draw_string(30, 30, "YOU WIN!", 0xF);
    } else {
        draw_string(30, 30, "AI WINS!", 0xF);
    }
    char score_str[24];
    snprintf(score_str, sizeof(score_str), "Score: %d - %d",
             g_game.player_score, g_game.enemy_score);
    draw_string(20, 50, score_str, 0xF);
    draw_string( 5, 75, "Press START to", 0xF);
    draw_string( 5, 85, "play again", 0xF);
    display_flush();
}

static void draw_playing_screen(void)
{
    fill_screen(0x0);

    draw_rect_filled(g_game.player.x, g_game.player.y,
                     g_game.player.w, g_game.player.h, 0xF);
    draw_rect_filled(g_game.enemy.x,  g_game.enemy.y,
                     g_game.enemy.w,  g_game.enemy.h,  0xF);
    draw_circle_filled(g_game.ball.x, g_game.ball.y, g_game.ball.r, 0xF);

    char s[4];
    snprintf(s, sizeof(s), "%d", g_game.player_score);
    draw_string(30, 5, s, 0xF);
    snprintf(s, sizeof(s), "%d", g_game.enemy_score);
    draw_string(90, 5, s, 0xF);

    // Dashed center line
    for (int y = 0; y < SCREEN_HEIGHT; y += 4) {
        set_pixel(SCREEN_WIDTH / 2, y, 0xF);
    }

    display_flush();
}

// --- Public API ---

esp_err_t display_init(void)
{
    // Configure DC and RST as output GPIOs
    gpio_config_t io_conf = {
        .pin_bit_mask = (1ULL << OLED_DC) | (1ULL << OLED_RST),
        .mode         = GPIO_MODE_OUTPUT,
        .pull_up_en   = GPIO_PULLUP_DISABLE,
        .pull_down_en = GPIO_PULLDOWN_DISABLE,
        .intr_type    = GPIO_INTR_DISABLE,
    };
    gpio_config(&io_conf);

    // Hardware reset
    gpio_set_level(OLED_RST, 0);
    vTaskDelay(pdMS_TO_TICKS(10));
    gpio_set_level(OLED_RST, 1);
    vTaskDelay(pdMS_TO_TICKS(10));

    // Init SPI bus (SPI2_HOST, IOMUX pins on ESP32-S3)
    spi_bus_config_t buscfg = {
        .mosi_io_num    = OLED_MOSI,
        .miso_io_num    = -1,
        .sclk_io_num    = OLED_SCLK,
        .quadwp_io_num  = -1,
        .quadhd_io_num  = -1,
        .max_transfer_sz = FRAMEBUF_SIZE,
    };
    ESP_ERROR_CHECK(spi_bus_initialize(SPI2_HOST, &buscfg, SPI_DMA_CH_AUTO));

    spi_device_interface_config_t devcfg = {
        .clock_speed_hz = 10 * 1000 * 1000,
        .mode           = 0,
        .spics_io_num   = OLED_CS,
        .queue_size     = 1,
    };
    ESP_ERROR_CHECK(spi_bus_add_device(SPI2_HOST, &devcfg, &s_spi));

    // SSD1327 init sequence
    ssd1327_cmd(0xAE);        // display off
    ssd1327_cmd(0x81);        // set contrast
    ssd1327_cmd(0x80);
    ssd1327_cmd(0xA0);        // remap: col-remap | no-nibble-remap | COM-flip
    ssd1327_cmd(0x51);        // 0x51 not 0x53: bit1=0 → even pixel in high nibble, matches set_pixel
    ssd1327_cmd(0xA1);        // start line
    ssd1327_cmd(0x00);
    ssd1327_cmd(0xA2);        // display offset
    ssd1327_cmd(0x00);
    ssd1327_cmd(0xA6);        // all pixels off during init
    ssd1327_cmd(0xA8);        // multiplex ratio
    ssd1327_cmd(0x5F);        // 95 = 96 rows − 1 (correct for 128×96 panel)
    ssd1327_cmd(0xAB);        // function selection A
    ssd1327_cmd(0x01);
    ssd1327_cmd(0xB1);        // phase length
    ssd1327_cmd(0x11);        // 0x11 not 0xF1: correct charge/discharge timing
    ssd1327_cmd(0xB3);        // display clock
    ssd1327_cmd(0x00);
    ssd1327_cmd(0xB6);        // second pre-charge
    ssd1327_cmd(0x04);        // 0x04 not 0x0A
    ssd1327_cmd(0xBC);        // pre-charge voltage
    ssd1327_cmd(0x08);
    ssd1327_cmd(0xBE);        // VCOMH
    ssd1327_cmd(0x0F);        // 0x0F not 0x07: higher VCOMH → better contrast
    ssd1327_cmd(0xD5);        // function selection B
    ssd1327_cmd(0x62);
    ssd1327_cmd(0xFD);        // command lock
    ssd1327_cmd(0x12);        // 0x12 = unlock (ensure all commands are accepted)
    ssd1327_cmd(0xA4);        // normal display (show framebuffer)
    ssd1327_cmd(0xAF);        // display on
    vTaskDelay(pdMS_TO_TICKS(100)); // 100ms settling time

    fill_screen(0x0);
    display_flush();

    ESP_LOGI(TAG, "SSD1327 initialized");
    return ESP_OK;
}

void display_draw(void)
{
    // Read game state without mutex - one torn frame is acceptable
    switch (g_game.state) {
        case GAME_STATE_WAITING:  draw_start_screen();    break;
        case GAME_STATE_PLAYING:  draw_playing_screen();  break;
        case GAME_STATE_OVER:     draw_game_over_screen(); break;
    }
}
